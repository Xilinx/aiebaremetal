## CMakeLists.txt
```
# Copyright (C) 2025 - 2026 Advanced Micro Devices, Inc.
# SPDX-License-Identifier: Apache-2.0

cmake_minimum_required(VERSION 3.20.0)

set(CMAKE_EXPORT_COMPILE_COMMANDS ON)
# Repo root: this app lives at <repo>/example/testkernel_zephyr.
get_filename_component(AIEBAREMETAL_SRC_DIR ${CMAKE_CURRENT_SOURCE_DIR}/../.. ABSOLUTE)
set(AIE_RT_SRC_DIR ${AIEBAREMETAL_SRC_DIR}/thirdparty/aielib/aie-rt)

find_package(Zephyr REQUIRED HINTS $ENV{ZEPHYR_BASE})
project(aie-rt-tests)

set(ENV{DEBUG} "true")

# AIE generation comes from build_zephyr.sh (-DAIE_GEN). Selects HW_GEN/geometry
# in src/include/hw_config.h. Defaults to VEK385 (gen 5 / AIE2PS); VEK280 -> 2 (AIE-ML).
if(NOT DEFINED AIE_GEN)
  set(AIE_GEN 5)
endif()
target_compile_definitions(app PUBLIC AIE_GEN=${AIE_GEN})
target_compile_definitions(app PUBLIC __AIEZEPHYR__=1)

include(${AIE_RT_SRC_DIR}/zephyr.cmake)
add_aie_rt_library(app)

include(${AIEBAREMETAL_SRC_DIR}/zephyr.cmake)
add_aiebaremetal_library(app)

target_sources(app PRIVATE src/graph.cpp)
target_include_directories(app PRIVATE src/)
```

## sample.yaml
```
# Copyright (C) 2025 - 2026 Advanced Micro Devices, Inc.
# SPDX-License-Identifier: Apache-2.0
sample:
  description: AIE-RT sample demonstrating AMD AI Engine Runtime integration
    with Zephyr
  name: AIE Runtime Test
common:
  tags: aie-rt
  integration_platforms:
    - native_sim
  harness: console
  harness_config:
    type: one_line
    regex:
      - "Hello from AIE-RT test"
tests:
  sample.aie-rt.test:
    tags: aie-rt
```

## prj.conf
```kconfig
# Copyright (C) 2025 - 2026 Advanced Micro Devices, Inc.
# SPDX-License-Identifier: Apache-2.0

#CONFIG_AIE_RT_LIB=y
CONFIG_STATIC_INIT_GNU=y
CONFIG_CPP=y
CONFIG_REQUIRES_FULL_LIBC=y
#CONFIG_LIBCPP_IMPLEMENTATION=y
CONFIG_GLIBCXX_LIBCPP=y
CONFIG_STD_CPP20=y
CONFIG_CPP_EXCEPTIONS=y
CONFIG_NEWLIB_LIBC=y
CONFIG_CPP_RTTI=y
CONFIG_PICOLIBC=y
CONFIG_POSIX_DEVICE_IO=y
CONFIG_POSIX_FD_MGMT=y
CONFIG_POSIX_FILE_SYSTEM=y
CONFIG_POSIX_SYSTEM_INTERFACES=y
CONFIG_NET_IPV4=y
CONFIG_NET_IPV6=y
CONFIG_NETWORKING=y
CONFIG_NET_SOCKETS=y
# Enable the random number generator subsystem
CONFIG_ENTROPY_GENERATOR=y
CONFIG_TEST_RANDOM_GENERATOR=y

# NB: the AIE register aperture is mapped at runtime by the aiebaremetal library
# (abr_map_aie_aperture) instead of a static SoC MMU-table entry. The kernel VM
# window sizing / 48-bit VA-PA needed for that aperture live in the board
# fragment boards/versal_apu.conf (merged after this file) for the MMU/APU build;
# the default versal2_rpu build has no MMU and uses identity addressing.
```

## boards/versal_apu.conf
```kconfig
# Copyright (C) 2025 - 2026 Advanced Micro Devices, Inc.
# SPDX-License-Identifier: Apache-2.0

# Default 16 KB malloc arena is too small for aie-rt FAL init.
# 8388608 = 8 MiB (decimal; hex rejected).
CONFIG_COMMON_LIBC_MALLOC_ARENA_SIZE=8388608

# 48-bit VA/PA to reach the AIE aperture at 0x20000000000 (2^41).
CONFIG_ARM64_VA_BITS_48=y
CONFIG_ARM64_PA_BITS_48=y

# VM window for kernel + device MMIO maps (UART). AIE aperture is direct-mapped
# at its physical base, outside this window, so 256 MB suffices.
CONFIG_KERNEL_VM_SIZE=0x10000000

# Direct (VA==phys) map for the AIE aperture (avoids the dynamic-VA -EBUSY
# collision with identity-mapped DDR/peripherals; uses large blocks).
CONFIG_KERNEL_DIRECT_MAP=y
CONFIG_MAX_XLAT_TABLES=24

# Keep board default TFA on (bl31 @EL3 -> Zephyr; bundled into the .BIN).
```

## dts/bindings/xlnx,aiengine.yaml
```yaml
# Copyright (C) 2025 - 2026 Advanced Micro Devices, Inc.
# SPDX-License-Identifier: Apache-2.0
description: "Xilinx AI Engine (AIE) is a high-performance, programmable architecture designed for accelerating machine learning workloads. It provides a flexible and efficient platform for deploying AI models, enabling developers to optimize performance and power efficiency for a wide range of applications, including computer vision, natural language processing, and more."

compatible: "xlnx,aiengine"

include: base.yaml

properties:
  reg:
    required: true

  num-cols:
    type: int

  num-rows:
    type: int

  mem-rows:
    type: int

  mem-row-start:
    type: int

  shim-rows:
    type: int

  shim-row-start:
    type: int

  core-rows:
    type: int

  core-row-start:
    type: int

  aie-gen:
    type: int

  col-shift:
    type: int

  row-shift:
    type: int
```

## src/example_generated_graphs.h
```c
/**<!--
 * Copyright (C) 2026 Advanced Micro Devices, Inc.
 * Auto-generated graph class
 * -->*/

#ifndef __GENERATED_GRAPH_CLASS_H__
#define __GENERATED_GRAPH_CLASS_H__

#include "aeg_baremetal_api.h"
#if defined(__AIESIM__) || defined(__ADF_FRONTEND__)
#include "aeg_baremetal_graph_sim_base.h"
#endif

class GmioApiImpl;
class ExternalBufferApiImpl;
class RtpApiImpl;
class SharedBufferApiImpl;

namespace aeg {
struct gradf {};
} // namespace aeg

template <typename GraphTag> struct AEGGraph;

class aeg_gradf : public AbrGraph {
  public:
    abr::InputGMIO in;
    abr::OutputGMIO out;
    aeg_gradf(const std::string &graphName = "gradf")
        : AbrGraph(graphName), in("gradf.in", this->getGraphImpl(), nullptr),
          out("gradf.out", this->getGraphImpl(), nullptr) {}
};

template <> struct AEGGraph<aeg::gradf> : aeg_gradf {
    using aeg_gradf::aeg_gradf;
};

#endif // __GENERATED_GRAPH_CLASS_H__
```

## src/graph.cpp
```c
// Copyright (C) 2025 - 2026 Advanced Micro Devices, Inc.
// SPDX-License-Identifier: Apache-2.0
#include "aiebaremetal.h"
#include "aeg_platform.h"
#if defined(__ADF_FRONTEND__)
#include "graph.h"
myGraph gradf;
#endif

#include "config.h"
#include <fstream>
#include <xaiengine.h>

AbrGraph gr("gradf");

int main(int argc, char **argv) {
    for (int i = 0; i < 100; i++) {
        printf(".");
    }
    printf("\n");

#if defined(AEG_HARDWARE) && defined(_RPU_) && !defined(__ZEPHYR__)
    Xil_DCacheDisable();
    Xil_ICacheDisable();
#endif

    gr.init();
    gr.getaiedevinst();
    //PROFILE_ID handle0 = gr.start_profiling("gradf.in", io_total_stream_running_to_idle_cycles);
    XTime tStart, tEnd;
    XTime_GetTime(&tStart);
    int32_t *inputArray = (int32_t *)gr.malloc(DATA_LENGTH * sizeof(int32_t));
    int32_t *outputArray = (int32_t *)gr.malloc(DATA_LENGTH * sizeof(int32_t));
    int32_t *outputArray_gold = (int32_t *)gr.malloc(DATA_LENGTH * sizeof(int32_t));
    gr.run(1);
    for (int i = 0; i < DATA_LENGTH; i++) {
        inputArray[i] = i + 1;
        outputArray_gold[i] = inputArray[i] * inputArray[i];
    }

    gr.gm2aie_nb("gradf.in", reinterpret_cast<char *>(&inputArray[0]), DATA_LENGTH * sizeof(int32_t));
    gr.aie2gm_nb("gradf.out", reinterpret_cast<char *>(&outputArray[0]), DATA_LENGTH * sizeof(int32_t));
    gr.gmio_wait("gradf.out"); // assuming data from gm1 are processed by the graph and output to gm2

    gr.wait();

    XTime_GetTime(&tEnd);
    printf("Output took %llu clock cycles.\n", 2 * (tEnd - tStart));
    printf("Output 2 took %.2f us.\n", 1.0 * (tEnd - tStart) / (COUNTS_PER_SECOND / 1000000));

    gr.end();
#if 0
    if (handle0 != -1) {
        long long cycle_count0 = gr.read_profiling(handle0);
        gr.stop_profiling(handle0);
        printf("cycle_count0 = %lld\n", cycle_count0);
    }
#endif

    for (int i = 0; i < DATA_LENGTH; i++) {
        std::cout << "value " << outputArray[i] << ", ";
        if (outputArray[i] != outputArray_gold[i]) {
            std::cout << "\n at data[" << i << "] incorrect Test Failed \n";
            return -1;
        }
    }

    std::cout << "\n" << "Test Passed\n";

    gr.free(inputArray);
    gr.free(outputArray);
    gr.free(outputArray_gold);
    return 0;
}
```

## src/graph.h
```c
// Copyright (C) 2025 - 2026 Advanced Micro Devices, Inc.
// SPDX-License-Identifier: Apache-2.0
#include "square.h"
#include <adf.h>
// #define ENABLE_PLIO
// #define ENABLE_SHARE_BUFFER
#include "config.h"
using namespace adf;
struct myGraph : public adf::graph {
  public:
    adf::kernel sq;

    adf::input_gmio in;
    adf::output_gmio out;
#if (__AIE_ARCH__ != AIE)
    adf::shared_buffer<int32> mem_buff;
#endif

    int a = 2;

    myGraph() {
        in = input_gmio::create("gmio1", 64, 1);
        out = output_gmio::create("gmio2", 64, 1);
        sq = adf::kernel::create(square);
        adf::source(sq) = "src/square.cc";
        runtime<ratio>(sq) = 0.6;
        adf::location<adf::kernel>(sq) = adf::tile(4, 1);
#if (__AIE_ARCH__ != AIE && defined(ENABLE_SHARE_BUFFER))
        mem_buff = adf::shared_buffer<int32>::create({1024, 48}, 1, 1);
        num_buffers(mem_buff) = 2;
        // col 1, mem tile row 0(abs row 1), share_buffer 0x0 addr start
        location<buffer>(mem_buff) = {address((2 + (2 * 0) - 1), 1, 0), address((2 + (2 * 0) - 1), 1, 262144)};
        adf::connect<window<1024>>(in.out[0], mem_buff.in[0]);
        adf::connect<window<128>>(mem_buff.out[0], sq.in[0]);
        adf::connect<window<128>>(sq.out[0], out.in[0]);

        tiling_parameters memtile1_in = {.buffer_dimension = {1024, 48}, .tiling_dimension = {1024, 48}, .offset = {
                                             0,
                                             0
                                         }};
        tiling_parameters memtile1_out = {
            .buffer_dimension = {1024, 48}, .tiling_dimension = {1, 48}, .offset = {0, 0}, .tile_traversal = {
                {.dimension = 0, .stride = 1, .wrap = 1024},
                {.dimension = 1,
                 .stride = 1,
                 .wrap = 1 }
            }};
        write_access(mem_buff.in[0]) = tiling(memtile1_in);
        read_access(mem_buff.out[0]) = tiling(memtile1_out);
#else
        adf::connect<window<WIN_SIZE * sizeof(int32)>>(in.out[0], async(sq.in[0]));
        adf::connect<window<WIN_SIZE * sizeof(int32)>>(async(sq.out[0]), out.in[0]);

#endif
    }
};
```

## src/graph_new_api.cpp
```c
// Copyright (C) 2025 - 2026 Advanced Micro Devices, Inc.
// SPDX-License-Identifier: Apache-2.0

#if defined(__AEG_METADATA_ONLY__) || defined(__ADF_FRONTEND__)
#include "graph.h"
myGraph gradf;
#else
#include "aiebaremetal.h"
#include "aeg_platform.h"

#include "config.h"
#include <fstream>
#include <xaiengine.h>

AEGGraph<aeg::gradf> gr;

int main(int argc, char **argv) {
#if defined(__ADF_FRONTEND__)
    gradf.init();
#else
#ifdef _RPU_
    Xil_DCacheDisable();
    Xil_ICacheDisable();
#endif
#endif
    gr.init();
    gr.getaiedevinst();

    PROFILE_ID handle0 = gr.in.start_profiling(io_total_stream_running_to_idle_cycles);

    XTime tStart, tEnd;
    XTime_GetTime(&tStart);
    int32_t *inputArray = (int32_t *)gr.malloc(DATA_LENGTH * sizeof(int32_t));
    int32_t *outputArray = (int32_t *)gr.malloc(DATA_LENGTH * sizeof(int32_t));
    int32_t *outputArray_gold = (int32_t *)gr.malloc(DATA_LENGTH * sizeof(int32_t));

    gr.run(1);

    for (int i = 0; i < DATA_LENGTH; i++) {
        inputArray[i] = i + 1;
        outputArray_gold[i] = inputArray[i] * inputArray[i];
    }

    gr.in.gm2aie_nb(reinterpret_cast<char *>(&inputArray[0]), DATA_LENGTH * sizeof(int32_t));

    gr.out.aie2gm_nb(reinterpret_cast<char *>(&outputArray[0]), DATA_LENGTH * sizeof(int32_t));

    gr.out.gmio_wait();

    gr.wait();

    XTime_GetTime(&tEnd);
    printf("Output took %llu clock cycles.\n", 2 * (tEnd - tStart));
    printf("Output 2 took %.2f us.\n", 1.0 * (tEnd - tStart) / (COUNTS_PER_SECOND / 1000000));

    gr.end();

    if (handle0 != -1) {
        long long cycle_count0 = gr.in.read_profiling(handle0);
        gr.in.stop_profiling(handle0);
        printf("cycle_count0 = %lld\n", cycle_count0);
        fflush(stdout);
    }

    for (int i = 0; i < DATA_LENGTH; i++) {
        std::cout << "value " << outputArray[i] << ", ";
        fflush(stdout);
        if (outputArray[i] != outputArray_gold[i]) {
            std::cout << "\n at data[" << i << "] incorrect Test Failed \n";
            fflush(stdout);
            return -1;
        }
    }

    std::cout << "\n" << "Test Passed (New API)\n";
    fflush(stdout);

    gr.free(inputArray);
    gr.free(outputArray);
    gr.free(outputArray_gold);
    return 0;
}
#endif /* !__AEG_METADATA_ONLY__ && !__ADF_FRONTEND__ */
```

## src/square.cc
```c
// Copyright (C) 2025 - 2026 Advanced Micro Devices, Inc.
// SPDX-License-Identifier: Apache-2.0

#include "config.h"
#include <adf.h>
#include <aie_api/aie.hpp>
#include <aie_api/aie_adf.hpp>
#include <stdio.h>
#define VECTOR_LENGTH 16
#define FORWARD_TEST
void domath(int32 VEC[], int len) {
    for (int l = 0; l < len; l++) {
        VEC[l] *= VEC[l];
    }
}
void square(input_window_int32 *win, output_window_int32 *out) {
    int method = 2;
    switch (method) {
    case 0:
        int32_t VEC[WIN_SIZE];
        for (unsigned i = 0; i < DATA_LENGTH / WIN_SIZE; i++) {
            window_acquire(win);
            window_acquire(out);
            for (unsigned w = 0; w < WIN_SIZE / VECTOR_LENGTH; w++)
                chess_prepare_for_pipelining {
                    aie::vector<int32_t, VECTOR_LENGTH> temp_a = window_readincr_v<VECTOR_LENGTH>(win);
                    auto temp_b = aie::mul(temp_a, temp_a);
                    aie::store_unaligned_v<VECTOR_LENGTH>(VEC + w * VECTOR_LENGTH, temp_b.to_vector<int32_t>());
                    for (int s = 0; s < VECTOR_LENGTH; s++) {
                        auto vv = VEC + w * VECTOR_LENGTH;
                        printf("vv[%d] is %d\n", s, vv[s]);
                    }
                    window_writeincr(out, aie::load_v<VECTOR_LENGTH>(VEC + w * VECTOR_LENGTH));
                }
            /*
                    for (unsigned w = 0; w < WIN_SIZE / VECTOR_LENGTH; w++)
                        chess_prepare_for_pipelining{
                            //domath(VEC + w * VECTOR_LENGTH, VECTOR_LENGTH);

                            window_writeincr(out, aie::load_v<VECTOR_LENGTH>(VEC+w * VECTOR_LENGTH));

                    }
                    */

            window_release(out);
            window_release(win);
        }
        break;

    case 1:
#ifndef FORWARD_TEST
        int32_t A[DATA_LENGTH];
#else
        int32_t A[VECTOR_LENGTH];
#endif
        ///*
        for (unsigned i = 0; i < DATA_LENGTH / WIN_SIZE; i++) {
            window_acquire(win);
            for (unsigned w = 0; w < WIN_SIZE / VECTOR_LENGTH; w++)
                chess_prepare_for_pipelining {
                    aie::vector<int32_t, VECTOR_LENGTH> temp_a = window_readincr_v<VECTOR_LENGTH>(win);
#ifndef FORWARD_TEST
                    aie::store_unaligned_v<VECTOR_LENGTH>(A + i * WIN_SIZE + (w * VECTOR_LENGTH), temp_a);
#else
                    aie::store_unaligned_v<VECTOR_LENGTH>(A, temp_a);
#endif
                }
            window_release(win);
        }
#ifndef FORWARD_TEST
        for (int i = 0; i < DATA_LENGTH; i++) {
            A[i] *= A[i];
        }
#else
        for (int j = 0; j < DATA_LENGTH / VECTOR_LENGTH; j++) {
            for (int i = 0; i < VECTOR_LENGTH; i++) {
                A[i] *= A[i];
            }
        }
#endif

        for (unsigned i = 0; i < DATA_LENGTH / WIN_SIZE; i++) {
            window_acquire(out);
            for (unsigned z = 0; z < WIN_SIZE / VECTOR_LENGTH; z++)
                chess_prepare_for_pipelining {
#ifndef FORWARD_TEST
                    window_writeincr(out, aie::load_v<VECTOR_LENGTH>(A + i * WIN_SIZE + (z * VECTOR_LENGTH)));
#else
                    window_writeincr(out, aie::load_v<VECTOR_LENGTH>(A));
#endif
                }
            window_release(out);
        }
        //*/
        break;

    case 2:
        // printf("\nsquare log end \n");
        printf("square log\n");
        for (unsigned i = 0; i < DATA_LENGTH / WIN_SIZE; i++) {
            window_acquire(win);
            window_acquire(out);
            for (int k = 0; k < WIN_SIZE; k++) {
                int j = window_readincr(win);
                // printf("data[%d of %d] is %d \n", i * WIN_SIZE + k, DATA_LENGTH, j);
                window_writeincr(out, j * j);
            }
            window_release(out);
            window_release(win);
        }
        printf("\nsquare log end \n");
        break;
    }
}
```

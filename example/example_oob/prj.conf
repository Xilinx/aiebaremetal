## prj.conf
```kconfig
# Copyright (C) 2025 - 2026 Advanced Micro Devices, Inc.
# SPDX-License-Identifier: Apache-2.0

#CONFIG_AIE_RT_LIB=y
CONFIG_STATIC_INIT_GNU=y
CONFIG_CPP=y
CONFIG_REQUIRES_FULL_LIBC=y
#CONFIG_LIBCPP_IMPLEMENTATION=y
CONFIG_GLIBCXX_LIBCPP=y
CONFIG_STD_CPP20=y
CONFIG_CPP_EXCEPTIONS=y
CONFIG_NEWLIB_LIBC=y
CONFIG_CPP_RTTI=y
CONFIG_PICOLIBC=y
CONFIG_POSIX_DEVICE_IO=y
CONFIG_POSIX_FD_MGMT=y
CONFIG_POSIX_FILE_SYSTEM=y
CONFIG_POSIX_SYSTEM_INTERFACES=y
CONFIG_NET_IPV4=y
CONFIG_NET_IPV6=y
CONFIG_NETWORKING=y
CONFIG_NET_SOCKETS=y
# Enable the random number generator subsystem
CONFIG_ENTROPY_GENERATOR=y
CONFIG_TEST_RANDOM_GENERATOR=y
```

## src/graph.cpp
```c
// Copyright (C) 2025 - 2026 Advanced Micro Devices, Inc.
// SPDX-License-Identifier: Apache-2.0
#include <fstream>
#include <vector>
#include <sstream>
#include <xaiengine.h>
#include "aiebaremetal.h"
#include "aeg_platform.h"

#if defined(__AIESIM__) || defined(__ADF_FRONTEND__)
#include "graph.h"
myGraph gradf;
BaremetalGraphSim gr("gradf");
#else
BaremetalGraph gr("gradf");
#endif
#include "kernels/config.h"

#if defined(__AIESIM__) || defined(__ADF_FRONTEND__)
void adf_run() {
    std::cout << " adf_run alloc " << NUM_HW_ROWS * MAT_A_CHUNK_SIZE / 1024 << " kB" << std::endl;
    std::vector<int32_t *> inputArray(NUM_HW_ROWS, NULL), inputArrayB(NUM_HW_ROWS, NULL),
        outputArray(NUM_HW_ROWS, NULL);
    int32_t *mem_in = (int32_t *)GMIO::malloc(NUM_HW_ROWS * MAT_A_CHUNK_SIZE);
    int32_t *mem_in_b = (int32_t *)GMIO::malloc(NUM_ELMNTS * sizeof(int32_t));

    int32_t *mem_out = (int32_t *)GMIO::malloc(NUM_HW_ROWS * MAT_A_CHUNK_SIZE);
    std::cout << "after alloc size = " << NUM_HW_ROWS * MAT_A_CHUNK_SIZE / 1024 << "kb" << std::endl;
    for (int i = 0; i < NUM_HW_ROWS; i++) {
        std::cout << " 1 i = " << i << std::endl;
        inputArray[i] = mem_in + i * MAT_A_CHUNK;
        inputArrayB[i] = mem_in_b + i * MAT_A_CHUNK;
        outputArray[i] = mem_out + i * MAT_A_CHUNK;
        for (int j = 0; j < MAT_A_CHUNK; j++) {
            inputArray[i][j] = i + 1;
            inputArrayB[i][j] = i + 2;
            outputArray[i][j] = i + 1;
        }
    }

    std::cout << "before run" << std::endl;
    gradf.run(1);
    std::cout << "after run" << std::endl;
    for (int i = 0; i < NUM_HW_ROWS; i++) {
        gradf.in[i].gm2aie_nb(inputArray[i], MAT_A_CHUNK_SIZE);
        gradf.in[i].gm2aie_nb(inputArrayB[i], NUM_ELMNTS * sizeof(int32_t));
    }

    for (int i = 0; i < NUM_HW_ROWS; i++) {
        gradf.out[i].aie2gm_nb(outputArray[i], MAT_A_CHUNK_SIZE);
        gradf.out[i].wait(); // assuming data from gm1 are processed by the graph and output to gm2
    }

    std::cout << "before end" << std::endl;
    gradf.end();
    for (auto x : inputArray) {
        GMIO::free(x);
    }
    for (auto x : inputArrayB) {
        GMIO::free(x);
    }
    for (auto x : outputArray) {
        GMIO::free(x);
    }
}
#endif
int main(int argc, char **argv) {
#if defined(__AIESIM__) || defined(__ADF_FRONTEND__)
    std::cout << "gradf.a  =" << gradf.a << " before init" << std::endl;
    gradf.init();
    std::cout << "after init" << gradf.a << std::endl;
#else
    // FIXME, should handle the sync in runtime api
#ifdef _RPU_
    // RPU need to disable data cache, without cache diable app will stuck
#if !defined(__ZEPHYR__)
    Xil_DCacheDisable();
    Xil_ICacheDisable();
    printf("Cache disabled for RPU\n");
#endif
#endif

#endif
    gr.init();

    int32_t **input_a;
    int32_t **input_a_hw_rows;
    int32_t **input_b;
    int32_t **input_b_hw_rows;
    int32_t **output_aie;
    int32_t **output_aie_hw_rows;
    int32_t **output_cpu;

    std::cout << "Allocating memory for input and output matrices" << std::endl;
    int32_t *mem_a = (int32_t *)gr.malloc(NUM_ROWS * sizeof(int32_t *) +
                                          NUM_HW_ROWS * sizeof(int32_t *) +
                                          NUM_ROWS * NUM_COLS * sizeof(int32_t));
    int32_t *mem_b = (int32_t *)gr.malloc(NUM_ROWS * sizeof(int32_t *) +
                                          NUM_HW_ROWS * sizeof(int32_t *) +
                                          NUM_ROWS * NUM_COLS * sizeof(int32_t));
    int32_t *mem_out = (int32_t *)gr.malloc(NUM_ROWS * sizeof(int32_t *) +
                                            NUM_HW_ROWS * sizeof(int32_t *) +
                                            NUM_ROWS * NUM_COLS * sizeof(int32_t));
    output_cpu = (int32_t **) malloc(NUM_ROWS * sizeof(int32_t *) +
                                     NUM_HW_ROWS * sizeof(int32_t *) +
                                     NUM_ROWS * NUM_COLS * sizeof(int32_t));
    if (!mem_a || !mem_b || !mem_out || !output_cpu) {
        std::cout << "[INFO] Failed to allocate memory" << std::endl;
        return EXIT_FAILURE;
    }

    std::cout << "Inidializing input and output matrices" << std::endl;
    input_a = (int32_t **) mem_a;
    input_a_hw_rows = (int32_t **) mem_a + NUM_ROWS;
    input_b = (int32_t **) mem_b;
    input_b_hw_rows = (int32_t **) mem_b + NUM_ROWS;
    output_aie = (int32_t **) mem_out;
    output_aie_hw_rows = (int32_t **) mem_out + NUM_ROWS;
    for (int i = 0; i < NUM_ROWS; i++) {
        input_a[i] = (int32_t *)(input_a + NUM_ROWS + NUM_HW_ROWS) + i * NUM_COLS;
        input_b[i] = (int32_t *)(input_b + NUM_ROWS + NUM_HW_ROWS) + i * NUM_COLS;
        output_aie[i] = (int32_t *)(output_aie + NUM_ROWS + NUM_HW_ROWS) + i * NUM_COLS;
        output_cpu[i] = (int32_t *)(output_cpu + NUM_ROWS + NUM_HW_ROWS) + i * NUM_COLS;
    }

    for (int i = 0; i < NUM_ROWS; i++) {
        for (int j = 0; j < NUM_COLS; j++) {
            int32_t value = (i * NUM_COLS + j) % 10;

            value = value == 0 ? 1 : value;
            input_a[i][j] = value;
            input_b[i][j] = 1;
            output_aie[i][j] = 0;
            output_cpu[i][j] = 0;
        }
    }

    for (int i = 0; i < NUM_HW_ROWS; i++) {
        input_a_hw_rows[i] = (int32_t *)(input_a + NUM_ROWS + NUM_HW_ROWS) + i * (NUM_ROWS_PER_HW_ROW * NUM_COLS);
        input_b_hw_rows[i] = (int32_t *)(input_b + NUM_ROWS + NUM_HW_ROWS) + i * (NUM_ROWS_PER_HW_ROW * NUM_COLS);
        output_aie_hw_rows[i] = (int32_t *)(output_aie + NUM_ROWS + NUM_HW_ROWS) + i * (NUM_ROWS_PER_HW_ROW * NUM_COLS);
    }

#if not defined(__AIESIM__) && not defined(__ADF_FRONTEND__)
        // to make sure we can read correct output data from ddr, we need to first flush the output data into DDR
        // WITHOUT doing this, we can not read the correct data , even if we called the invalid funciton
        // this should be the xil api bug
#endif

    std::cout << "Starting graph execution" << std::endl;
    gr.run(1);
    std::cout << "graph started" << std::endl;

    std::ostringstream in_ostr, out_ostr;
    for (int i = 0; i < NUM_HW_ROWS; i++) {
        std::ostringstream in_ostr;

        in_ostr << "gradf.in[" << i << "]";
        gr.gm2aie_nb((char *)in_ostr.str().c_str(),
                     reinterpret_cast<char *>(input_a_hw_rows[i]),
                     NUM_ROWS_PER_HW_ROW * NUM_COLS * sizeof(int32_t));
        gr.gm2aie_nb((char *)in_ostr.str().c_str(),
                     reinterpret_cast<char *>(input_b_hw_rows[0]),
                     NUM_ROWS * NUM_COLS * sizeof(int32_t));
    }
    std::vector<std::string> out_strs;
    for (int i = 0; i < NUM_HW_ROWS; i++) {
        std::ostringstream out_ostr;
        out_ostr << "gradf.out[" << i << "]";
        out_strs.push_back(out_ostr.str());
        std::cout << "Issuing gmio read for " << out_ostr.str() << std::endl;
        gr.aie2gm((char *)out_ostr.str().c_str(),
                  reinterpret_cast<char *>(output_aie_hw_rows[i]),
                  NUM_ROWS_PER_HW_ROW * NUM_COLS * sizeof(int32_t));
    }

    for (int i = 0; i < NUM_HW_ROWS; i++) {
        std::cout << "Waiting for output from " << out_strs[i] << std::endl;
        gr.gmio_wait((char *)out_strs[i].c_str()); // assuming data from gm1 are processed by the graph and output to
                                                   // gm2
    }
    std::cout << "Ending graph execution" << std::endl;
    gr.end();
    std::cout << "Graph execution ended" << std::endl;

    printf("Computing matrix multiplication on CPU for verification...\n");
    /* Compute matrix multiplication on CPU for result verification */
    for (int i = 0; i < NUM_ROWS; i++) {
        for (int j = 0; j < NUM_ROWS; j++) {
            if (!(j % 128)) {
                printf("\ri=%d j=%d", i, j);
                fflush(stdout);
            }
            for (int k = 0; k < NUM_COLS; k++) {
                output_cpu[i][j] += input_a[i][k] * input_b[k][j];
            }
        }
    }
    printf("\n");
    printf("Verifying results...\n");
    /* Z-ordering and compare with CPU */
    for (int i = 0; i < NUM_COLS / (WIN_SIZE / NUM_ROWS_PER_TILE); i++) {
        for (int j = 0; j < NUM_HW_ROWS; j++) {
            for (int k = 0; k < NUM_HW_COLS; k++) {
                for (int m = 0; m < WIN_SIZE / NUM_ROWS_PER_TILE; m++) {
                    for (int l = 0; l < NUM_ROWS_PER_TILE; l++) {
                        int dst_row = j * NUM_ROWS_PER_HW_ROW + k * NUM_ROWS_PER_TILE + l;
                        int dst_col = i * (WIN_SIZE / NUM_ROWS_PER_TILE) + m;
                        int src_idx = j * MAT_A_CHUNK + i * NUM_ROWS_PER_HW_ROW * (WIN_SIZE / NUM_ROWS_PER_TILE) + k * WIN_SIZE + m * NUM_ROWS_PER_TILE + l;
                        int *src = (int *)((int **)output_aie_hw_rows + NUM_HW_ROWS);
                        if (!(dst_col % 128)) {
                            printf("\rChecking dst_row=%d dst_col=%d src_idx=%d", dst_row, dst_col, src_idx);
                            fflush(stdout);
                        }
                        if (src[src_idx] != output_cpu[dst_row][dst_col]) {
                            printf("\n[ERROR] Data mismatch at [%d][%d]: AIE = %d, CPU = %d\n", dst_row, dst_col, src[src_idx], output_cpu[dst_row][dst_col]);
                            printf("Test Failed!\n");
                            return -1;
                        }
                    }
                }
            }
        }
    }
    printf("\n");

    std::cout << "OOB Test Passed\n";
    return 0;
}
```

## src/graph.h
```c
// Copyright (C) 2025 - 2026 Advanced Micro Devices, Inc.
// SPDX-License-Identifier: Apache-2.0
#include "kernels.h"
#include <string>
// #define ENABLE_PLIO
using namespace adf;
#define InitKernel(KERNEL, FUNC, FILEN, ROW, COL)                                                                      \
    {                                                                                                                  \
        KERNEL = adf::kernel::create(FUNC);                                                                            \
        adf::source(KERNEL) = FILEN;                                                                                   \
        adf::location<adf::kernel>(KERNEL) = tile(COL, ROW);                                                           \
        runtime<ratio>(KERNEL) = 0.9;                                                                                  \
    }
#if (__AIE_ARCH__ == ARCH_AIE)
#define STREAM_CONNECT(OUT, IN) adf::connect<cascade>(OUT, IN);
#else
#define STREAM_CONNECT(OUT, IN)
#endif
struct myGraph : public adf::graph {
  public:
    int a = 2;
    adf::kernel g_kernel[NUM_HW_ROWS][NUM_HW_COLS];
    adf::input_gmio in[NUM_HW_ROWS];
    adf::output_gmio out[NUM_HW_ROWS];
    void ConnectSystolicArray_Row_LToR(int r, int has_third_stream_out, adf::kernel *kernel, adf::input_gmio &in,
                                       adf::output_gmio &out, const char *start_kernel_file,
                                       const char *middle_kernel_file, const char *end_kernel_file) {
        InitKernel(kernel[0], OneInput, start_kernel_file, r, 0);
        adf::connect<window<WIN_SIZE_BYTES>>(in.out[0], async(kernel[0].in[0]));
        for (int i = 1; i < NUM_HW_COLS - 1; i++) {
            InitKernel(kernel[i], TwoInputs, middle_kernel_file, r, i);
            adf::connect<window<WIN_SIZE_BYTES>>(async(kernel[i - 1].out[0]), async(kernel[i].in[0]));
            adf::connect<window<WIN_SIZE_BYTES>>(async(kernel[i - 1].out[1]), async(kernel[i].in[1]));
            if (has_third_stream_out) {
                STREAM_CONNECT(kernel[i - 1].out[2], kernel[i].in[2]);
            }
        }
        InitKernel(kernel[NUM_HW_COLS - 1], OneOutput, end_kernel_file, r, NUM_HW_COLS - 1);
        adf::connect<window<WIN_SIZE_BYTES>>(async(kernel[NUM_HW_COLS - 2].out[0]),
                                             async(kernel[NUM_HW_COLS - 1].in[0]));
        adf::connect<window<WIN_SIZE_BYTES>>(async(kernel[NUM_HW_COLS - 2].out[1]),
                                             async(kernel[NUM_HW_COLS - 1].in[1]));
        if (has_third_stream_out) {
            STREAM_CONNECT(kernel[NUM_HW_COLS - 2].out[2], kernel[NUM_HW_COLS - 1].in[2]);
        }

        adf::connect<window<WIN_SIZE_BYTES>>(async(kernel[NUM_HW_COLS - 1].out[0]), out.in[0]);
    }
    void ConnectSystolicArray_Row_RToL(int r, int has_third_stream_out, adf::kernel *kernel, adf::input_gmio &in,
                                       adf::output_gmio &out, const char *start_kernel_file,
                                       const char *middle_kernel_file, const char *end_kernel_file) {
        InitKernel(kernel[NUM_HW_COLS - 1], OneInput, start_kernel_file, r, NUM_HW_COLS - 1);
        adf::connect<window<WIN_SIZE_BYTES>>(in.out[0], async(kernel[NUM_HW_COLS - 1].in[0]));
        for (int i = NUM_HW_COLS - 2; i > 0; i--) {
            InitKernel(kernel[i], TwoInputs, middle_kernel_file, r, i);
            adf::connect<window<WIN_SIZE_BYTES>>(async(kernel[i + 1].out[0]), async(kernel[i].in[0]));
            adf::connect<window<WIN_SIZE_BYTES>>(async(kernel[i + 1].out[1]), async(kernel[i].in[1]));
            if (has_third_stream_out) {
                STREAM_CONNECT(kernel[i + 1].out[2], kernel[i].in[2]);
            }
        }
        InitKernel(kernel[0], OneOutput, end_kernel_file, r, 0);
        adf::connect<window<WIN_SIZE_BYTES>>(async(kernel[1].out[0]), async(kernel[0].in[0]));
        adf::connect<window<WIN_SIZE_BYTES>>(async(kernel[1].out[1]), async(kernel[0].in[1]));
        if (has_third_stream_out) {
            STREAM_CONNECT(kernel[1].out[2], kernel[0].in[2]);
        }
        adf::connect<window<WIN_SIZE_BYTES>>(async(kernel[0].out[0]), out.in[0]);
    }
    myGraph() {
        std::ostringstream in_name, out_name;
        for (int r = 0; r < NUM_HW_ROWS; r++) {
            std::ostringstream in_name, out_name;
            in_name << "gmioin" << r;
            out_name << "gmioout" << r;
            in[r] = input_gmio::create(in_name.str(), 64, 1);
            out[r] = output_gmio::create(out_name.str(), 64, 1);
#if (__AIE_ARCH__ == ARCH_AIE)
            if ((r & 0x1) == 0) { // even
                ConnectSystolicArray_Row_LToR(r, 1, &g_kernel[r][0], in[r], out[r], "./src/kernels/one_input_aie.cc",
                                              "./src/kernels/two_inputs_aie.cc", "./src/kernels/one_output_aie.cc");
            } else {
                ConnectSystolicArray_Row_RToL(r, 1, &g_kernel[r][0], in[r], out[r], "./src/kernels/one_input_aie.cc",
                                              "./src/kernels/two_inputs_aie.cc", "./src/kernels/one_output_aie.cc");
            }
#else
            ConnectSystolicArray_Row_LToR(r, 0, &g_kernel[r][0], in[r], out[r], "./src/kernels/one_input.cc",
                                          "./src/kernels/two_inputs.cc", "./src/kernels/one_output.cc");

#endif
        }
    }
};
```

## src/graph_new_api.cpp
```c
// Copyright (C) 2026 Advanced Micro Devices, Inc.
// SPDX-License-Identifier: Apache-2.0

#if defined(__AEG_METADATA_ONLY__) || defined(__ADF_FRONTEND__)
#include "graph.h"
myGraph gradf;
#else
#include <sstream>
#include <vector>
#include <xaiengine.h>

#include "aiebaremetal.h"
#include "aeg_platform.h"

AEGGraph<aeg::gradf> gr;

#include "kernels/config.h"
#if 0  // adf_run() was used in the in-process sim flow (now removed)
void adf_run() {
    std::cout << " adf_run alloc " << NUM_HW_ROWS * MAT_A_CHUNK_SIZE / 1024 << " kB" << std::endl;
    std::vector<int32_t *> inputArray(NUM_HW_ROWS, NULL), inputArrayB(NUM_HW_ROWS, NULL),
        outputArray(NUM_HW_ROWS, NULL);
    int32_t *mem_in = (int32_t *)GMIO::malloc(NUM_HW_ROWS * MAT_A_CHUNK_SIZE);
    int32_t *mem_in_b = (int32_t *)GMIO::malloc(NUM_ELMNTS * sizeof(int32_t));

    int32_t *mem_out = (int32_t *)GMIO::malloc(NUM_HW_ROWS * MAT_A_CHUNK_SIZE);
    std::cout << "after alloc size = " << NUM_HW_ROWS * MAT_A_CHUNK_SIZE / 1024 << "kb" << std::endl;
    for (int i = 0; i < NUM_HW_ROWS; i++) {
        std::cout << " 1 i = " << i << std::endl;
        inputArray[i] = mem_in + i * MAT_A_CHUNK;
        inputArrayB[i] = mem_in_b + i * MAT_A_CHUNK;
        outputArray[i] = mem_out + i * MAT_A_CHUNK;
        for (int j = 0; j < MAT_A_CHUNK; j++) {
            inputArray[i][j] = i + 1;
            inputArrayB[i][j] = i + 2;
            outputArray[i][j] = i + 1;
        }
    }

    std::cout << "before run" << std::endl;
    gradf.run(1);
    std::cout << "after run" << std::endl;
    int rown = 1;
    for (int i = 0; i < rown; i++) {
        gradf.in[i].gm2aie_nb(inputArray[i], MAT_A_CHUNK_SIZE);
        gradf.in[i].gm2aie_nb(inputArrayB[i], NUM_ELMNTS * sizeof(int32_t));
    }

    for (int i = 0; i < rown; i++) {
        gradf.out[i].aie2gm_nb(outputArray[i], MAT_A_CHUNK_SIZE);
        gradf.out[i].wait(); // assuming data from gm1 are processed by the graph and output to gm2
    }

    std::cout << "before end" << std::endl;
    gradf.end();
    for (auto x : inputArray) {
        GMIO::free(x);
    }
    for (auto x : inputArrayB) {
        GMIO::free(x);
    }
    for (auto x : outputArray) {
        GMIO::free(x);
    }
}
#endif
int main(int argc, char **argv) {
#if defined(__ADF_FRONTEND__)
    std::cout << "gradf.a  =" << gradf.a << " before init" << std::endl;
    gradf.init();
    std::cout << "after init" << gradf.a << std::endl;
#else
    // FIXME, should handle the sync in runtime api
#endif
    const int rown = NUM_HW_ROWS;
    std::cout << "1 start--08 07" << std::endl;
    std::vector<int32_t *> inputArray(NUM_HW_ROWS, NULL), inputArrayB(NUM_HW_ROWS, NULL),
        outputArray(NUM_HW_ROWS, NULL);
    int32_t *mem_in = (int32_t *)gr.malloc(NUM_HW_ROWS * MAT_A_CHUNK_SIZE);
    int32_t *mem_in_b = (int32_t *)gr.malloc(NUM_ELMNTS * sizeof(int32_t));
    int32_t *mem_out = (int32_t *)gr.malloc(NUM_HW_ROWS * MAT_A_CHUNK_SIZE);
    for (int i = 0; i < rown; i++) {
        std::cout << " 1 i = " << i << std::endl;
        inputArray[i] = mem_in + i * MAT_A_CHUNK;
        inputArrayB[i] = mem_in_b + i * MAT_A_CHUNK;
        outputArray[i] = mem_out + i * MAT_A_CHUNK;
        for (int j = 0; j < MAT_A_CHUNK; j++) {
            inputArray[i][j] = ((j) / MAT_SIZE) + 1 + i;
            inputArrayB[i][j] = 1;
            outputArray[i][j] = 2;
        }
#if not defined(__AIESIM__) && not defined(__ADF_FRONTEND__)
        // to make sure we can read correct output data from ddr, we need to first flush the output data into DDR
        // WITHOUT doing this, we can not read the correct data , even if we called the invalid funciton
        // this should be the xil api bug
#endif
    }
    std::cout << "2" << std::endl;

    gr.init();
    gr.run(1);

    std::ostringstream in_ostr, out_ostr;
    for (int i = 0; i < rown; i++) {
        std::ostringstream in_ostr;
        in_ostr << "gradf.in[" << i << "]";
        gr.in[i].gm2aie_nb(reinterpret_cast<char *>(inputArray[i]), MAT_A_CHUNK_SIZE);
        gr.in[i].gm2aie_nb(reinterpret_cast<char *>(inputArrayB[i]), NUM_ELMNTS * sizeof(int32_t));
    }
    for (int i = 0; i < rown; i++) {
        std::cout << "MAT_A_CHUNK_SIZE " << MAT_A_CHUNK_SIZE << std::endl;
        gr.out[i].aie2gm_nb(reinterpret_cast<char *>(outputArray[i]), MAT_A_CHUNK_SIZE);
    }

    for (int i = 0; i < rown; i++) {
        gr.out[i].gmio_wait();
    }
    std::cout << "6. run--3-" << std::endl;
    gr.end();

    // Validation checks
    bool test_passed = true;
    int error_count = 0;
    int unchanged_count = 0;
    int zero_count = 0;
    const int32_t INITIAL_VALUE = 2;

    std::cout << "\n=== Starting Output Validation ===" << std::endl;

    for (int j = 0; j < rown; j++) {
        for (int i = 0; i < MAT_A_CHUNK; i++) {
            if (outputArray[j][i] == INITIAL_VALUE) {
                unchanged_count++;
                if (unchanged_count <= 10) {
                    printf("ERROR: outputArray[%d][%d] unchanged from initial value %d\n", j, i, INITIAL_VALUE);
                }
            }

            if (outputArray[j][i] == 0) {
                zero_count++;
                if (zero_count <= 10) {
                    printf("WARNING: outputArray[%d][%d] is zero\n", j, i);
                }
            }

            if (i < 16) {
                printf("outputArray[%d][%d] value is %d\n", j, i, outputArray[j][i]);
            }
        }
    }

    std::cout << "\n=== Validation Results ===" << std::endl;
    std::cout << "Total elements checked: " << (rown * MAT_A_CHUNK) << std::endl;
    std::cout << "Elements unchanged from initial value: " << unchanged_count << std::endl;
    std::cout << "Elements with zero value: " << zero_count << std::endl;

    if (unchanged_count > 0) {
        test_passed = false;
        error_count++;
        std::cout << "FAIL: " << unchanged_count << " elements were not updated by the graph" << std::endl;
    }

    int nonzero_count = (rown * MAT_A_CHUNK) - zero_count;
    if (nonzero_count == 0) {
        test_passed = false;
        error_count++;
        std::cout << "FAIL: All output values are zero" << std::endl;
    } else {
        std::cout << "PASS: " << nonzero_count << " elements have non-zero values" << std::endl;
    }

    std::cout << "\n=== Test Result ===" << std::endl;
    if (test_passed) {
        std::cout << "SUCCESS: OOB Test PASSED with new api" << std::endl;
        return 0;
    } else {
        std::cout << "FAILURE: OOB Test FAILED with " << error_count << " validation error(s)" << std::endl;
        return 1;
    }
}
#endif /* !__AEG_METADATA_ONLY__ && !__ADF_FRONTEND__ */
```

## src/kernels.h
```c
// Copyright (C) 2025 - 2026 Advanced Micro Devices, Inc.
// SPDX-License-Identifier: Apache-2.0
#ifndef __KERNELS__
#define __KERNELS__
#include "kernels/config.h"
#include <adf.h>
#if (__AIE_ARCH__ == ARCH_AIE)
void OneInput(input_window<int32> *__restrict dataIn, output_window<int32> *__restrict aOut,
              output_window<int32> *__restrict result, output_cascade<acc48> *bOut);

void TwoInputs(input_window<int32> *__restrict aIn, input_window<int32> *__restrict bypassResult,
               input_cascade<acc48> *bIn, output_window<int32> *__restrict aOut,
               output_window<int32> *__restrict result, output_cascade<acc48> *bOut);

void OneOutput(input_window<int32> *__restrict aIn, input_window<int32> *__restrict bypassResult,
               input_cascade<acc48> *bIn, output_window<int32> *__restrict result);
#else
void OneInput(input_window_uint32 *dataIn, output_window_uint32 *dataOut, output_window_uint32 *result);

void TwoInputs(input_window_uint32 *dataIn, input_window_uint32 *bypassResult, output_window_uint32 *dataOut,
               output_window_uint32 *result);

void OneOutput(input_window_uint32 *dataIn, input_window_uint32 *bypassResult, output_window_uint32 *result);
#endif
#endif
```
